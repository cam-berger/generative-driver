/* Board wiring only; upstream application, framing and CRC are unchanged. */
&usart2 {
    status = "okay";
    modbus0 {
        compatible = "zephyr,modbus-serial";
        status = "okay";
    };
};
